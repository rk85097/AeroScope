#pragma once

#include <Arduino.h>
#include <pgmspace.h>

namespace micro_radar {
namespace aircraft_type_icon_db {

constexpr uint8_t kIconProp = 0;
constexpr uint8_t kIconTwinProp = 1;
constexpr uint8_t kIconRegionalJet = 2;
constexpr uint8_t kIconNarrowJet = 3;
constexpr uint8_t kIconHeavyJet = 4;
constexpr uint8_t kIconUnknown = 5;
constexpr uint8_t kIconHelicopter = 6;
constexpr uint8_t kIconNotFound = 255;

inline uint32_t encodeTypeCode(const char* text) {
  uint32_t value = 0;
  for (uint8_t i = 0; i < 4; ++i) {
    char c = text && text[i] ? text[i] : '\0';
    if (c >= 'a' && c <= 'z') c -= 32;
    uint8_t n = 0;
    if (c >= 'A' && c <= 'Z') n = static_cast<uint8_t>(c - 'A' + 1);
    else if (c >= '0' && c <= '9') n = static_cast<uint8_t>(c - '0' + 27);
    value = value * 37 + n;
  }
  return value;
}

constexpr uint16_t kTypeIconCount = 2767;
const uint32_t kTypeIconTable[kTypeIconCount] PROGMEM = {
  0x0001C488, 0x0001C488, 0x000671C0, 0x000671C8, // `JUN1`..AAT4
  0x00067A10, 0x00067D71, 0x00067EB0, 0x0006A5B8, // AA1..AB11
  0x0006A5D8, 0x0006A5F0, 0x0006AF18, 0x0006B0D1, // AB15..ACAM
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  0x00A61350, 0x00A61478, 0x00A63BC8, // Z42..Z50
};

inline uint8_t lookup(const String& typeCode) {
  const uint32_t key = encodeTypeCode(typeCode.c_str());
  int lo = 0;
  int hi = static_cast<int>(kTypeIconCount) - 1;
  while (lo <= hi) {
    const int mid = lo + ((hi - lo) / 2);
    const uint32_t packed = pgm_read_dword(&kTypeIconTable[mid]);
    const uint32_t itemKey = packed >> 3;
    if (itemKey == key) return static_cast<uint8_t>(packed & 0x07);
    if (itemKey < key) lo = mid + 1;
    else hi = mid - 1;
  }
  return kIconNotFound;
}

}  // namespace aircraft_type_icon_db
}  // namespace micro_radar
